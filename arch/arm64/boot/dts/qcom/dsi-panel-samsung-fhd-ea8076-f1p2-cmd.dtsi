/* Copyright (c) 2015, The Linux Foundation. All rights reserved.
 *
 * This program is free software; you can redistribute it and/or modify
 * it under the terms of the GNU General Public License version 2 and
 * only version 2 as published by the Free Software Foundation.
 *
 * This program is distributed in the hope that it will be useful,
 * but WITHOUT ANY WARRANTY; without even the implied warranty of
 * MERCHANTABILITY or FITNESS FOR A PARTICULAR PURPOSE.  See the
 * GNU General Public License for more details.
 */

/*---------------------------------------------------------------------------
 * This file is autogenerated file using gcdb parser. Please do not edit it.
 * Update input XML file to add a new entry or update variable in this file
 * VERSION = "1.0"
 *---------------------------------------------------------------------------*/
&soc {
	dsi_samsung_fhd_ea8076_f1p2_cmd: qcom,mdss_dsi_samsung_fhd_ea8076_f1p2_cmd {
				qcom,mdss-dsi-panel-name = "samsung ea8076 fhd cmd dsi panel";
				qcom,mdss-dsi-panel-id = <0x00>;
				qcom,mdss-dsi-panel-model = "SAMSUNG FHD EA8076 CMD PANEL";
				qcom,mdss-dsi-panel-sleepwrmod = <0x00>;
				qcom,mdss-dsi-panel-type = "dsi_cmd_mode";
				qcom,mdss-dsi-virtual-channel-id = <0x00>;
				qcom,mdss-dsi-stream = <0x00>;
				qcom,mdss-dsi-bpp = <0x18>;
				qcom,mdss-dsi-underflow-color = <0xff>;
				qcom,mdss-dsi-border-color = <0x00>;
				qcom,mdss-dsi-traffic-mode = "burst_mode";
				qcom,mdss-dsi-bllp-eof-power-mode;
				qcom,mdss-dsi-bllp-power-mode;
				qcom,ulps-enabled;
				qcom,mdss-dsi-lp11-init;
				qcom,mdss-dsi-lane-0-state;
				qcom,mdss-dsi-lane-1-state;
				qcom,mdss-dsi-lane-2-state;
				qcom,mdss-dsi-lane-3-state;
				qcom,mdss-brightness-max-level = <0x7ff>;
				qcom,bl-update-flag = "delay_until_first_frame";
				qcom,mdss-dsi-dma-trigger = "trigger_sw";
				qcom,mdss-dsi-mdp-trigger = "none";
				qcom,mdss-dsi-bl-dcs-type-ss;
				qcom,mdss-dsi-reset-sequence = <0x00 0x01 0x01 0x0a>;
				qcom,mdss-pan-physical-width-dimension = <0x44>;
				qcom,mdss-pan-physical-height-dimension = <0x93>;
				qcom,mdss-dsi-te-pin-select = <0x01>;
				qcom,mdss-dsi-wr-mem-start = <0x2c>;
				qcom,mdss-dsi-wr-mem-continue = <0x3c>;
				qcom,mdss-dsi-te-dcs-command = <0x01>;
				qcom,mdss-dsi-te-check-enable;
				qcom,mdss-dsi-te-using-te-pin;
				qcom,mdss-dsi-tx-eot-append;
				qcom,mdss-dsi-panel-hdr-enabled;
				qcom,mdss-dsi-panel-hdr-color-primaries = <0x38a4 0x3c8c 0x7d00 0x4268 0x3c8c 0x7530 0x1f40 0xbb8>;
				qcom,mdss-dsi-panel-peak-brightness = <0x419ce0>;
				qcom,mdss-dsi-panel-blackness-level = <0xc9e>;
				qcom,mdss-dsi-panel-fod-dimlayer-enabled;
				qcom,dispparam-enabled;
				qcom,mdss-panel-on-dimming-delay = <0xc8>;
				qcom,mdss-dsi-panel-dc-threshold = <0x262>;
				qcom,esd-err-irq-gpio = <0xffffffff 0x05 0x2002>;
				qcom,disp-doze-backlight-threshold = <0x08>;
				qcom,disp-fod-off-dimming-delay = <0x55>;
				qcom,elvss_dimming_check_enable;
				qcom,mdss-dsi-panel-elvss-dimming-read-length = <0x01>;
				qcom,mdss-dsi-dispparam-elvss-dimming-offset-command = [39 01 00 00 00 00 02 b0 07];
				qcom,mdss-dsi-dispparam-elvss-dimming-offset-command-state = "dsi_hs_mode";
				qcom,mdss-dsi-dispparam-elvss-dimming-read-command = <0x6010001 0x1b7>;
				qcom,mdss-dsi-dispparam-elvss-dimming-read-command-state = "dsi_hs_mode";
				qcom,mdss-dsi-dispparam-hbm-fod-off-doze-hbm-on-command = [39 01 00 00 00 00 02 53 22 39 00 00 00 00 00 03 f0 5a 5a 39 00 00 00 00 00 03 b7 01 4b 39 00 00 00 00 00 02 b0 03 39 00 00 00 00 00 02 b7 49 39 00 00 00 00 00 02 b0 07 39 00 00 00 00 00 02 b7 91 39 01 00 00 01 00 03 f0 a5 a5];
				qcom,mdss-dsi-dispparam-hbm-fod-off-doze-hbm-on-command-state = "dsi_lp_mode";
				qcom,mdss-dsi-dispparam-hbm-fod-off-doze-lbm-on-command = [39 01 00 00 00 00 02 53 23 39 00 00 00 00 00 03 f0 5a 5a 39 00 00 00 00 00 03 b7 01 4b 39 00 00 00 00 00 02 b0 03 39 00 00 00 00 00 02 b7 49 39 00 00 00 00 00 02 b0 07 39 00 00 00 00 00 02 b7 91 39 01 00 00 01 00 03 f0 a5 a5];
				qcom,mdss-dsi-dispparam-hbm-fod-off-doze-lbm-on-command-state = "dsi_lp_mode";
				qcom,mdss-dsi-dispparam-hbm-fod-off-command = [39 01 00 00 00 00 02 53 20 39 00 00 00 00 00 03 f0 5a 5a 39 00 00 00 00 00 03 b7 01 4b 39 00 00 00 00 00 02 b0 03 39 00 00 00 00 00 02 b7 49 39 00 00 00 00 00 02 b0 07 39 00 00 00 00 00 02 b7 91 39 01 00 00 01 00 03 f0 a5 a5];
				qcom,mdss-dsi-dispparam-hbm-fod-off-command-state = "dsi_lp_mode";
				qcom,mdss-dsi-dispparam-hbm-fod-on-command = [39 00 00 00 00 00 03 f0 5a 5a 39 00 00 00 00 00 02 b0 03 39 00 00 00 00 00 02 b7 c9 39 00 00 00 00 00 02 b0 07 39 00 00 00 00 00 02 b7 91 39 00 00 00 00 00 03 b7 01 43 39 00 00 00 00 00 03 f0 a5 a5 39 01 00 00 01 00 02 53 e0];
				qcom,mdss-dsi-dispparam-hbm-fod-on-command-state = "dsi_lp_mode";
				qcom,mdss-dsi-t-clk-post = <0x1a>;
				qcom,mdss-dsi-t-clk-pre = <0x1e>;
				qcom,panel-supply-entries = <0x19>;
				qcom,mdss-dsi-bl-pmic-control-type = "bl_ctrl_dcs";
				qcom,mdss-dsi-bl-min-level = <0x02>;
				qcom,mdss-dsi-bl-max-level = <0x7ff>;
				qcom,mdss-dsi-mode-sel-gpio-state = "single_port";
				qcom,platform-te-gpio = <0xffffffff 0x08 0x00>;
				qcom,platform-reset-gpio = <0xffffffff 0x06 0x00>;
				phandle = <0x33>;

				qcom,mdss-dsi-display-timings {

					timing@0 {
						qcom,mdss-dsi-panel-width = <0x438>;
						qcom,mdss-dsi-panel-height = <0x924>;
						qcom,mdss-dsi-h-front-porch = <0x40>;
						qcom,mdss-dsi-h-back-porch = <0x40>;
						qcom,mdss-dsi-h-pulse-width = <0x14>;
						qcom,mdss-dsi-h-sync-skew = <0x00>;
						qcom,mdss-dsi-v-back-porch = <0x40>;
						qcom,mdss-dsi-v-front-porch = <0x40>;
						qcom,mdss-dsi-v-pulse-width = <0x14>;
						qcom,mdss-dsi-h-left-border = <0x00>;
						qcom,mdss-dsi-h-right-border = <0x00>;
						qcom,mdss-dsi-v-top-border = <0x00>;
						qcom,mdss-dsi-v-bottom-border = <0x00>;
						qcom,mdss-dsi-panel-framerate = <0x3c>;
						qcom,mdss-dsi-panel-clockrate = <0x4190ab00>;
						qcom,mdss-dsi-panel-jitter = <0x05 0x01>;
						qcom,mdss-dsi-on-command = [39 00 00 00 00 00 03 f0 5a 5a 39 00 00 00 00 00 03 fc 5a 5a 39 00 00 00 00 00 02 b0 0c 39 00 00 00 00 00 02 ff 10 39 00 00 00 00 00 02 b0 2f 39 01 00 00 00 00 02 d1 01 39 00 00 00 00 00 03 f0 a5 a5 39 01 00 00 00 00 03 fc a5 a5 05 01 00 00 0a 00 02 11 00 39 00 00 00 00 00 03 f0 5a 5a 39 00 00 00 00 00 02 35 00 39 00 00 00 00 00 03 b7 01 4b 39 00 00 00 00 00 02 b0 06 39 00 00 00 00 00 02 b7 10 39 01 00 00 00 00 03 f0 a5 a5 39 01 00 00 00 00 05 2b 00 00 09 23 39 00 00 00 00 00 03 f0 5a 5a 39 00 00 00 00 00 03 fc 5a 5a 39 00 00 00 00 00 02 b0 23 39 00 00 00 00 00 02 d1 33 39 00 00 00 00 00 0c e9 11 55 a6 75 a3 a6 37 be 00 1a b8 39 00 00 00 00 00 0c d9 14 00 00 8f 6e 00 00 8f 2e 6e 34 39 00 00 00 00 00 6d c0 31 01 03 00 06 00 00 00 00 00 00 00 00 00 00 00 00 50 00 00 40 3d 00 5e 00 00 00 20 07 20 30 58 00 00 00 00 00 00 e0 0b 75 d8 00 00 00 00 fc 00 00 00 f6 97 0f 6d e6 cd 05 21 8b ec ed ed ed 0d 3f 60 00 67 fd 6d 51 bc dd dd 00 00 07 00 00 20 00 00 00 00 00 00 00 00 00 00 00 00 70 2f 00 00 03 2e 3c 20 e0 00 00 00 00 00 06 8c 39 01 00 00 00 00 02 c0 31 39 00 00 00 00 00 07 e1 00 00 02 02 42 02 39 00 00 00 00 00 07 e2 00 00 00 00 00 00 39 00 00 00 00 00 02 b0 0c 39 00 00 00 00 00 02 e1 19 39 00 00 00 00 00 03 f0 a5 a5 39 01 00 00 00 00 03 fc a5 a5 39 00 00 00 00 00 02 53 20 39 00 00 00 00 00 03 51 00 00 39 01 00 00 43 00 02 55 00 05 01 00 00 00 00 02 29 00];
						qcom,mdss-dsi-off-command = [05 01 00 00 00 00 02 28 00 05 01 00 00 78 00 02 10 00];
						qcom,mdss-dsi-on-command-state = "dsi_lp_mode";
						qcom,mdss-dsi-off-command-state = "dsi_lp_mode";
						qcom,mdss-dsi-doze-hbm-command = [39 00 00 00 00 00 03 f0 5a 5a 39 00 00 00 00 00 02 d4 8b 39 00 00 00 00 00 02 b0 a5 39 00 00 00 00 00 02 c7 00 39 00 00 00 00 00 02 b0 69 39 00 00 00 00 00 03 b9 08 8f 39 01 00 00 01 00 02 53 22 39 01 00 00 00 00 03 f0 a5 a5];
						qcom,mdss-dsi-doze-lbm-command = [39 00 00 00 00 00 03 f0 5a 5a 39 00 00 00 00 00 02 d4 8b 39 00 00 00 00 00 02 b0 a5 39 00 00 00 00 00 02 c7 00 39 00 00 00 00 00 02 b0 69 39 00 00 00 00 00 03 b9 08 8f 39 01 00 00 00 00 02 53 23 39 01 00 00 00 00 03 f0 a5 a5];
						qcom,mdss-dsi-nolp-command = [05 01 00 00 22 00 02 28 00 39 01 00 00 00 00 02 53 20 05 01 00 00 00 00 02 29 00];
						qcom,mdss-dsi-doze-hbm-command-state = "dsi_lp_mode";
						qcom,mdss-dsi-doze-lbm-command-state = "dsi_lp_mode";
						qcom,mdss-dsi-nolp-command-state = "dsi_lp_mode";
						qcom,mdss-dsi-dispparam-acl-off-command = [39 01 00 00 00 00 02 55 00];
						qcom,mdss-dsi-dispparam-acl-off-command-state = "dsi_lp_mode";
						qcom,mdss-dsi-dispparam-acl-l1-command = [39 01 00 00 00 00 02 55 01];
						qcom,mdss-dsi-dispparam-acl-l1-command-state = "dsi_lp_mode";
						qcom,mdss-dsi-dispparam-acl-l2-command = [39 01 00 00 00 00 02 55 02];
						qcom,mdss-dsi-dispparam-acl-l2-command-state = "dsi_lp_mode";
						qcom,mdss-dsi-dispparam-acl-l3-command = [39 01 00 00 00 00 02 55 03];
						qcom,mdss-dsi-dispparam-acl-l3-command-state = "dsi_lp_mode";
						qcom,mdss-dsi-dispparam-hbm-off-command = [39 01 00 00 00 00 02 53 28];
						qcom,mdss-dsi-dispparam-hbm-off-command-state = "dsi_lp_mode";
						qcom,mdss-dsi-dispparam-hbm-on-command = [39 01 00 00 00 00 02 53 e8];
						qcom,mdss-dsi-dispparam-hbm-on-command-state = "dsi_lp_mode";
						qcom,mdss-dsi-dispparam-dimmingon-command = [39 01 00 00 01 00 02 53 28];
						qcom,mdss-dsi-dispparam-dimmingon-command-state = "dsi_lp_mode";
						qcom,mdss-dsi-dispparam-dimmingoff-command = [39 01 00 00 01 00 02 53 20];
						qcom,mdss-dsi-dispparam-dimmingoff-command-state = "dsi_lp_mode";
						qcom,mdss-dsi-dispparam-crc-srgb-on-command = [39 01 00 00 00 00 02 81 90 39 01 00 00 00 00 03 f0 5a 5a 39 01 00 00 00 00 02 b1 00 39 01 00 00 00 00 02 b0 01 39 01 00 00 00 00 16 b1 ae 0c 05 3f c6 14 05 07 aa 4a dd c8 c3 14 c0 e8 dc 19 ff f4 d9 39 01 00 00 00 00 02 b0 16 39 01 00 00 00 00 16 b1 bd 02 00 14 d1 00 04 07 aa 0c ec cb c8 0f dd d9 e4 05 ff ff ff 39 01 00 00 00 00 03 f0 a5 a5];
						qcom,mdss-dsi-dispparam-crc-srgb-on-command-state = "dsi_lp_mode";
						qcom,mdss-dsi-dispparam-crc-dcip3-on-command = [39 01 00 00 00 00 02 81 91 39 01 00 00 00 00 03 f0 5a 5a 39 01 00 00 00 00 02 b1 00 39 01 00 00 00 00 02 b0 01 39 01 00 00 00 00 16 b1 ae 0c 05 3f c6 14 05 07 aa 4a dd c8 c3 14 c0 e8 dc 19 ff f4 d9 39 01 00 00 00 00 02 b0 16 39 01 00 00 00 00 16 b1 cb 0b 01 0b ec 03 05 08 cf 14 fa fa e7 05 ee ee f2 00 ff ff ff 39 01 00 00 00 00 03 f0 a5 a5];
						qcom,mdss-dsi-dispparam-crc-dcip3-on-command-state = "dsi_lp_mode";
						qcom,mdss-dsi-dispparam-crc-off-command = [39 01 00 00 00 00 02 81 00 39 01 00 00 00 00 03 f0 5a 5a 39 01 00 00 00 00 02 b1 01 39 01 00 00 00 00 03 f0 a5 a5];
						qcom,mdss-dsi-dispparam-crc-off-command-state = "dsi_lp_mode";
						qcom,mdss-dsi-dispparam-elvss-dimming-off-command = [39 00 00 00 00 00 03 f0 5a 5a 39 00 00 00 00 00 02 b0 07 39 00 00 00 00 00 02 b7 91 39 01 00 00 01 00 03 f0 a5 a5];
						qcom,mdss-dsi-dispparam-elvss-dimming-off-command-state = "dsi_lp_mode";
						qcom,mdss-dsi-h-sync-pulse = <0x00>;
						qcom,mdss-dsi-panel-phy-timings = [00 24 0a 0a 26 25 09 0a 06 03 04 00 1e 1a];
						qcom,display-topology = <0x01 0x00 0x01>;
						qcom,default-topology-index = <0x00>;
					};
				};
			};
};
