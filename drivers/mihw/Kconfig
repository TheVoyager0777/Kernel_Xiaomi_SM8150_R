## drivers/mihw/Kconfig
```kconfig
config MIGT
	bool "smart sched"
	depends on MIHW
	help
	  Boost cpufreq when current frame drawing time too long

config MILLET
	bool "frozen framework"
	---help---
	  Mi frozen function
```

## drivers/mmc/Kconfig
```kconfig
#
# MMC subsystem configuration
#

menuconfig MMC
	tristate "MMC/SD/SDIO card support"
	depends on HAS_IOMEM
	help
	  This selects MultiMediaCard, Secure Digital and Secure
	  Digital I/O support.

	  If you want MMC/SD/SDIO support, you should say Y here and
	  also to your specific host controller driver.

config MMC_DEBUG
	bool "MMC debugging"
	depends on MMC != n
	help
	  This is an option for use by developers; most people should
	  say N here.  This enables MMC core and driver debugging.

config MMC_PERF_PROFILING
	bool "MMC performance profiling"
	depends on MMC != n
	default n
	help
	  If you say Y here, support will be added for collecting
	  performance numbers at the MMC Queue and Host layers.

config LGE_MMC_CLK_SCALE_DISABLE
	bool "disable clock scaling for mmc"
	default y
	help
	  If you say Y here, clock scaling for mmc device will be disabled.
	  Set Y in kernel/arch/arm/configs/XXXX_defconfig file.

config LGE_TRAY_EVENT
    bool "Show SD Card Detect pin status"
    depends on MACH_LGE
    default y
    help
        Support the uevent for SD Card TRAY status.

config LGE_ENABLE_MMC_CAP_SD_WAKE
    bool "enable interrupt during sleep status"
    default y
    help
        If you say Y here, SD Card interrupt pin is interruptable in sleep status.

if MMC

source "drivers/mmc/core/Kconfig"

source "drivers/mmc/host/Kconfig"

endif # MMC
```

## drivers/staging/mi-reclaim/Kconfig
```kconfig
config MI_RECLAIM
	bool "reclaim pages"
	default n
	---help---
	  Mi memory reclaim
```

## kernel/sched/walt/Kconfig
```kconfig
# SPDX-License-Identifier: GPL-2.0-only
#
# QTI WALT based scheduler
#
menu "QTI WALT based scheduler features"

config SCHED_WALT_ENHANCED
        default y
	tristate "Support window based load tracking"
	depends on SMP
	help
	This feature will allow the scheduler to maintain a tunable window
	based set of metrics for tasks and runqueues. These metrics can be
	used to guide task placement as well as task frequency requirements
	for cpufreq governors.

endmenu
```
